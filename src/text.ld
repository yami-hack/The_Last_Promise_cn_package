
SECTIONS{
	.	=	0x8012C9C;
	.8012C9C : 
	{
		*.o(.8012C9C)
	}
	
	.	=	0x8005B9C;
	.8005B9C : 
	{
		*.o(.8005B9C)
	}
	
	.	=	0x8005B60;
	.8005B60 : 
	{
		*.o(.8005B60)
	}
	
	.	=	0x8005C00;
	.8005C00 : 
	{
		*.o(.8005C00)
	}
}